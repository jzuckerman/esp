## socs/profpga-xcvu440-10acc/profpga-xcvu440-10acc_defconfig
```kconfig
CPU_ARCH = leon3
NCPU_TILE = 1
CONFIG_HAS_SG = y
CONFIG_NOC_ROWS = 4
CONFIG_NOC_COLS = 4
CONFIG_CACHE_EN = y
CONFIG_CACHE_RTL = y
CONFIG_CPU_CACHES = 512 4 4096 16
CONFIG_ACC_CACHES = 512 4
CONFIG_SLM_KBYTES = 256
#CONFIG_MON_DDR is not set
#CONFIG_MON_MEM is not set
#CONFIG_MON_INJ is not set
#CONFIG_MON_ROUTERS is not set
#CONFIG_MON_ACCELERATORS is not set
#CONFIG_MON_L2 is not set
#CONFIG_MON_LLC is not set
#CONFIG_MON_DVFS is not set
TILE_0_0 = 0 mem mem 0 0 0
TILE_0_1 = 1 misc IO 0 0 0
TILE_0_2 = 2 acc SORT_STRATUS 0 0 0 basic_dma32 1 sld
TILE_0_3 = 3 mem mem 0 0 0
TILE_1_0 = 4 cpu cpu 0 0 0
TILE_1_1 = 5 acc CHOLESKY_STRATUS 0 0 0 basic_dma32 1 sld
TILE_1_2 = 6 acc VITDODEC_STRATUS 0 0 0 basic_dma32 0 sld
TILE_1_3 = 7 acc SPMV_STRATUS 0 0 0 basic_dma32 1 sld
TILE_2_0 = 8 acc FFT_STRATUS 0 0 0 basic_fx32_dma32 1 sld
TILE_2_1 = 9 acc NIGHTVISION_STRATUS 0 0 0 fast_dma32_img1024_pxl3 1 sld
TILE_2_2 = 10 acc MRIQ_STRATUS 0 0 0 basic_p4_a1_dma32 1 sld
TILE_2_3 = 11 acc CONV2D_STRATUS 0 0 0 basic_dma32 1 sld
TILE_3_0 = 12 mem mem 0 0 0
TILE_3_1 = 13 acc GEMM_STRATUS 0 0 0 basic_chk2048_dma32_word32_paral8 1 sld
TILE_3_2 = 14 acc SVHN_MLP_HLS4ML 0 0 0 dma32_w32 1 sld
TILE_3_3 = 15 mem mem 0 0 0
#CONFIG_HAS_DVFS is not set
CONFIG_VF_POINTS = 4
POWER_0_0 = mem 0 0 0 0 0 0 0 0 0 0 0 0 
POWER_0_1 = IO 0 0 0 0 0 0 0 0 0 0 0 0 
POWER_0_2 = SORT_STRATUS 0.0 0.0 0.0 0.0 0.0 0.0 0.0 0.0 0.0 0.0 0.0 0.0 
POWER_0_3 = mem 0 0 0 0 0 0 0 0 0 0 0 0 
POWER_1_0 = cpu 0 0 0 0 0 0 0 0 0 0 0 0 
POWER_1_1 = CHOLESKY_STRATUS 0.0 0.0 0.0 0.0 0.0 0.0 0.0 0.0 0.0 0.0 0.0 0.0 
POWER_1_2 = VITDODEC_STRATUS 0.0 0.0 0.0 0.0 0.0 0.0 0.0 0.0 0.0 0.0 0.0 0.0 
POWER_1_3 = SPMV_STRATUS 0.0 0.0 0.0 0.0 0.0 0.0 0.0 0.0 0.0 0.0 0.0 0.0 
POWER_2_0 = FFT_STRATUS 0.0 0.0 0.0 0.0 0.0 0.0 0.0 0.0 0.0 0.0 0.0 0.0 
POWER_2_1 = NIGHTVISION_STRATUS 0.0 0.0 0.0 0.0 0.0 0.0 0.0 0.0 0.0 0.0 0.0 0.0 
POWER_2_2 = MRIQ_STRATUS 0.0 0.0 0.0 0.0 0.0 0.0 0.0 0.0 0.0 0.0 0.0 0.0 
POWER_2_3 = CONV2D_STRATUS 0.0 0.0 0.0 0.0 0.0 0.0 0.0 0.0 0.0 0.0 0.0 0.0 
POWER_3_0 = mem 0 0 0 0 0 0 0 0 0 0 0 0 
POWER_3_1 = GEMM_STRATUS 0.0 0.0 0.0 0.0 0.0 0.0 0.0 0.0 0.0 0.0 0.0 0.0 
POWER_3_2 = SVHN_MLP_HLS4ML 0.0 0.0 0.0 0.0 0.0 0.0 0.0 0.0 0.0 0.0 0.0 0.0 
POWER_3_3 = mem 0 0 0 0 0 0 0 0 0 0 0 0 
```

## socs/profpga-xcvu440-12acc/profpga-xcvu440-12acc_defconfig
```kconfig
CPU_ARCH = leon3
NCPU_TILE = 1
#CONFIG_HAS_SG is not set
CONFIG_NOC_ROWS = 4
CONFIG_NOC_COLS = 4
CONFIG_CACHE_EN = y
CONFIG_CACHE_RTL = y
CONFIG_CPU_CACHES = 512 4 2048 16
CONFIG_ACC_CACHES = 512 4
CONFIG_SLM_KBYTES = 0
#CONFIG_MON_DDR is not set
#CONFIG_MON_MEM is not set
#CONFIG_MON_INJ is not set
#CONFIG_MON_ROUTERS is not set
#CONFIG_MON_ACCELERATORS is not set
#CONFIG_MON_L2 is not set
#CONFIG_MON_LLC is not set
#CONFIG_MON_DVFS is not set
TILE_0_0 = 0 acc SORT_STRATUS 0 0 0 basic_dma32 1 sld
TILE_0_1 = 1 acc SORT_STRATUS 0 0 0 basic_dma32 1 sld
TILE_0_2 = 2 acc SORT_STRATUS 0 0 0 basic_dma32 1 sld
TILE_0_3 = 3 acc NIGHTVISION_STRATUS 0 0 0 fast_dma32_img1024_pxl3 1 sld
TILE_1_0 = 4 misc IO 0 0 0
TILE_1_1 = 5 cpu cpu 0 0 0
TILE_1_2 = 6 acc NIGHTVISION_STRATUS 0 0 0 fast_dma32_img1024_pxl3 1 sld
TILE_1_3 = 7 acc NIGHTVISION_STRATUS 0 0 0 fast_dma32_img1024_pxl3 1 sld
TILE_2_0 = 8 acc FFT_STRATUS 0 0 0 basic_fx32_dma32 1 sld
TILE_2_1 = 9 acc FFT_STRATUS 0 0 0 basic_fx32_dma32 1 sld
TILE_2_2 = 10 acc SPMV_STRATUS 0 0 0 basic_dma32 1 sld
TILE_2_3 = 11 acc SPMV_STRATUS 0 0 0 basic_dma32 1 sld
TILE_3_0 = 12 mem mem 0 0 0
TILE_3_1 = 13 acc FFT_STRATUS 0 0 0 basic_fx32_dma32 1 sld
TILE_3_2 = 14 acc SPMV_STRATUS 0 0 0 basic_dma32 1 sld
TILE_3_3 = 15 mem mem 0 0 0
#CONFIG_HAS_DVFS is not set
CONFIG_VF_POINTS = 4
POWER_0_0 = SORT_STRATUS 0.0 0.0 0.0 0.0 0.0 0.0 0.0 0.0 0.0 0.0 0.0 0.0 
POWER_0_1 = SORT_STRATUS 0.0 0.0 0.0 0.0 0.0 0.0 0.0 0.0 0.0 0.0 0.0 0.0 
POWER_0_2 = SORT_STRATUS 0.0 0.0 0.0 0.0 0.0 0.0 0.0 0.0 0.0 0.0 0.0 0.0 
POWER_0_3 = NIGHTVISION_STRATUS 0.0 0.0 0.0 0.0 0.0 0.0 0.0 0.0 0.0 0.0 0.0 0.0 
POWER_1_0 = IO 0 0 0 0 0 0 0 0 0 0 0 0 
POWER_1_1 = cpu 0 0 0 0 0 0 0 0 0 0 0 0 
POWER_1_2 = NIGHTVISION_STRATUS 0.0 0.0 0.0 0.0 0.0 0.0 0.0 0.0 0.0 0.0 0.0 0.0 
POWER_1_3 = NIGHTVISION_STRATUS 0.0 0.0 0.0 0.0 0.0 0.0 0.0 0.0 0.0 0.0 0.0 0.0 
POWER_2_0 = FFT_STRATUS 0.0 0.0 0.0 0.0 0.0 0.0 0.0 0.0 0.0 0.0 0.0 0.0 
POWER_2_1 = FFT_STRATUS 0.0 0.0 0.0 0.0 0.0 0.0 0.0 0.0 0.0 0.0 0.0 0.0 
POWER_2_2 = SPMV_STRATUS 0.0 0.0 0.0 0.0 0.0 0.0 0.0 0.0 0.0 0.0 0.0 0.0 
POWER_2_3 = SPMV_STRATUS 0.0 0.0 0.0 0.0 0.0 0.0 0.0 0.0 0.0 0.0 0.0 0.0 
POWER_3_0 = mem 0 0 0 0 0 0 0 0 0 0 0 0 
POWER_3_1 = FFT_STRATUS 0.0 0.0 0.0 0.0 0.0 0.0 0.0 0.0 0.0 0.0 0.0 0.0 
POWER_3_2 = SPMV_STRATUS 0.0 0.0 0.0 0.0 0.0 0.0 0.0 0.0 0.0 0.0 0.0 0.0 
POWER_3_3 = mem 0 0 0 0 0 0 0 0 0 0 0 0 
```

## socs/profpga-xcvu440-12synth/profpga-xcvu440-12synth_defconfig
```kconfig
CPU_ARCH = leon3
NCPU_TILE = 4
CONFIG_HAS_SG = y
CONFIG_NOC_ROWS = 5
CONFIG_NOC_COLS = 5
CONFIG_CACHE_EN = y
CONFIG_CACHE_RTL = y
CONFIG_CPU_CACHES = 512 4 4096 16
CONFIG_ACC_CACHES = 512 4
CONFIG_SLM_KBYTES = 256
#CONFIG_MON_DDR is not set
#CONFIG_MON_MEM is not set
#CONFIG_MON_INJ is not set
#CONFIG_MON_ROUTERS is not set
#CONFIG_MON_ACCELERATORS is not set
#CONFIG_MON_L2 is not set
#CONFIG_MON_LLC is not set
#CONFIG_MON_DVFS is not set
TILE_0_0 = 0 mem mem 0 0 0
TILE_0_1 = 1 acc SYNTH_STRATUS 0 0 0 basic_dma32 1 sld
TILE_0_2 = 2 acc SYNTH_STRATUS 0 0 0 basic_dma32 1 sld
TILE_0_3 = 3 mem mem 0 0 0
TILE_0_4 = 4 empty empty 0 0 0
TILE_1_0 = 5 acc SYNTH_STRATUS 0 0 0 basic_dma32 1 sld
TILE_1_1 = 6 cpu cpu 0 0 0
TILE_1_2 = 7 cpu cpu 0 0 0
TILE_1_3 = 8 acc SYNTH_STRATUS 0 0 0 basic_dma32 1 sld
TILE_1_4 = 9 empty empty 0 0 0
TILE_2_0 = 10 acc SYNTH_STRATUS 0 0 0 basic_dma32 1 sld
TILE_2_1 = 11 acc SYNTH_STRATUS 0 0 0 basic_dma32 1 sld
TILE_2_2 = 12 acc SYNTH_STRATUS 0 0 0 basic_dma32 1 sld
TILE_2_3 = 13 acc SYNTH_STRATUS 0 0 0 basic_dma32 1 sld
TILE_2_4 = 14 misc IO 0 0 0
TILE_3_0 = 15 acc SYNTH_STRATUS 0 0 0 basic_dma32 1 sld
TILE_3_1 = 16 cpu cpu 0 0 0
TILE_3_2 = 17 cpu cpu 0 0 0
TILE_3_3 = 18 acc SYNTH_STRATUS 0 0 0 basic_dma32 1 sld
TILE_3_4 = 19 empty empty 0 0 0
TILE_4_0 = 20 mem mem 0 0 0
TILE_4_1 = 21 acc SYNTH_STRATUS 0 0 0 basic_dma32 1 sld
TILE_4_2 = 22 acc SYNTH_STRATUS 0 0 0 basic_dma32 1 sld
TILE_4_3 = 23 mem mem 0 0 0
TILE_4_4 = 24 empty empty 0 0 0
#CONFIG_HAS_DVFS is not set
CONFIG_VF_POINTS = 4
POWER_0_0 = mem 0 0 0 0 0 0 0 0 0 0 0 0 
POWER_0_1 = SYNTH_STRATUS 0.0 0.0 0.0 0.0 0.0 0.0 0.0 0.0 0.0 0.0 0.0 0.0 
POWER_0_2 = SYNTH_STRATUS 0.0 0.0 0.0 0.0 0.0 0.0 0.0 0.0 0.0 0.0 0.0 0.0 
POWER_0_3 = mem 0 0 0 0 0 0 0 0 0 0 0 0 
POWER_0_4 = empty 0 0 0 0 0 0 0 0 0 0 0 0 
POWER_1_0 = SYNTH_STRATUS 0.0 0.0 0.0 0.0 0.0 0.0 0.0 0.0 0.0 0.0 0.0 0.0 
POWER_1_1 = cpu 0 0 0 0 0 0 0 0 0 0 0 0 
POWER_1_2 = cpu 0 0 0 0 0 0 0 0 0 0 0 0 
POWER_1_3 = SYNTH_STRATUS 0.0 0.0 0.0 0.0 0.0 0.0 0.0 0.0 0.0 0.0 0.0 0.0 
POWER_1_4 = empty 0 0 0 0 0 0 0 0 0 0 0 0 
POWER_2_0 = SYNTH_STRATUS 0.0 0.0 0.0 0.0 0.0 0.0 0.0 0.0 0.0 0.0 0.0 0.0 
POWER_2_1 = SYNTH_STRATUS 0.0 0.0 0.0 0.0 0.0 0.0 0.0 0.0 0.0 0.0 0.0 0.0 
POWER_2_2 = SYNTH_STRATUS 0.0 0.0 0.0 0.0 0.0 0.0 0.0 0.0 0.0 0.0 0.0 0.0 
POWER_2_3 = SYNTH_STRATUS 0.0 0.0 0.0 0.0 0.0 0.0 0.0 0.0 0.0 0.0 0.0 0.0 
POWER_2_4 = IO 0 0 0 0 0 0 0 0 0 0 0 0 
POWER_3_0 = SYNTH_STRATUS 0.0 0.0 0.0 0.0 0.0 0.0 0.0 0.0 0.0 0.0 0.0 0.0 
POWER_3_1 = cpu 0 0 0 0 0 0 0 0 0 0 0 0 
POWER_3_2 = cpu 0 0 0 0 0 0 0 0 0 0 0 0 
POWER_3_3 = SYNTH_STRATUS 0.0 0.0 0.0 0.0 0.0 0.0 0.0 0.0 0.0 0.0 0.0 0.0 
POWER_3_4 = empty 0 0 0 0 0 0 0 0 0 0 0 0 
POWER_4_0 = mem 0 0 0 0 0 0 0 0 0 0 0 0 
POWER_4_1 = SYNTH_STRATUS 0.0 0.0 0.0 0.0 0.0 0.0 0.0 0.0 0.0 0.0 0.0 0.0 
POWER_4_2 = SYNTH_STRATUS 0.0 0.0 0.0 0.0 0.0 0.0 0.0 0.0 0.0 0.0 0.0 0.0 
POWER_4_3 = mem 0 0 0 0 0 0 0 0 0 0 0 0 
POWER_4_4 = empty 0 0 0 0 0 0 0 0 0 0 0 0 
```

## socs/profpga-xcvu440-7synth/profpga-xcvu440-7synth_defconfig
```kconfig
CPU_ARCH = leon3
NCPU_TILE = 2
CONFIG_HAS_SG = y
CONFIG_NOC_ROWS = 4
CONFIG_NOC_COLS = 4
CONFIG_CACHE_EN = y
CONFIG_CACHE_RTL = y
CONFIG_CPU_CACHES = 512 4 4096 16
CONFIG_ACC_CACHES = 512 4
CONFIG_SLM_MBYTES = 1
#CONFIG_MON_DDR is not set
#CONFIG_MON_MEM is not set
#CONFIG_MON_INJ is not set
#CONFIG_MON_ROUTERS is not set
#CONFIG_MON_ACCELERATORS is not set
#CONFIG_MON_L2 is not set
#CONFIG_MON_LLC is not set
#CONFIG_MON_DVFS is not set
TILE_0_0 = 0 mem mem 0 0 0
TILE_0_1 = 1 acc SYNTH_STRATUS 0 0 0 basic_dma32 1 sld
TILE_0_2 = 2 acc SYNTH_STRATUS 0 0 0 basic_dma32 1 sld
TILE_0_3 = 3 mem mem 0 0 0
TILE_1_0 = 4 misc IO 0 0 0
TILE_1_1 = 5 cpu cpu 0 0 0
TILE_1_2 = 6 cpu cpu 0 0 0
TILE_1_3 = 7 acc SYNTH_STRATUS 0 0 0 basic_dma32 1 sld
TILE_2_0 = 8 acc SYNTH_STRATUS 0 0 0 basic_dma32 1 sld
TILE_2_1 = 9 cpu cpu 0 0 0
TILE_2_2 = 10 cpu cpu 0 0 0
TILE_2_3 = 11 acc SYNTH_STRATUS 0 0 0 basic_dma32 1 sld
TILE_3_0 = 12 mem mem 0 0 0
TILE_3_1 = 13 acc SYNTH_STRATUS 0 0 0 basic_dma32 1 sld
TILE_3_2 = 14 acc SYNTH_STRATUS 0 0 0 basic_dma32 1 sld
TILE_3_3 = 15 mem mem 0 0 0
#CONFIG_HAS_DVFS is not set
CONFIG_VF_POINTS = 4
POWER_0_0 = mem 0 0 0 0 0 0 0 0 0 0 0 0 
POWER_0_1 = SYNTH_STRATUS 0.0 0.0 0.0 0.0 0.0 0.0 0.0 0.0 0.0 0.0 0.0 0.0 
POWER_0_2 = SYNTH_STRATUS 0.0 0.0 0.0 0.0 0.0 0.0 0.0 0.0 0.0 0.0 0.0 0.0 
POWER_0_3 = mem 0 0 0 0 0 0 0 0 0 0 0 0 
POWER_1_0 = IO 0 0 0 0 0 0 0 0 0 0 0 0 
POWER_1_1 = cpu 0 0 0 0 0 0 0 0 0 0 0 0 
POWER_1_2 = cpu 0 0 0 0 0 0 0 0 0 0 0 0 
POWER_1_3 = SYNTH_STRATUS 0.0 0.0 0.0 0.0 0.0 0.0 0.0 0.0 0.0 0.0 0.0 0.0 
POWER_2_0 = SYNTH_STRATUS 0.0 0.0 0.0 0.0 0.0 0.0 0.0 0.0 0.0 0.0 0.0 0.0 
POWER_2_1 = cpu 0 0 0 0 0 0 0 0 0 0 0 0 
POWER_2_2 = cpu 0 0 0 0 0 0 0 0 0 0 0 0 
POWER_2_3 = SYNTH_STRATUS 0.0 0.0 0.0 0.0 0.0 0.0 0.0 0.0 0.0 0.0 0.0 0.0 
POWER_3_0 = mem 0 0 0 0 0 0 0 0 0 0 0 0 
POWER_3_1 = SYNTH_STRATUS 0.0 0.0 0.0 0.0 0.0 0.0 0.0 0.0 0.0 0.0 0.0 0.0 
POWER_3_2 = SYNTH_STRATUS 0.0 0.0 0.0 0.0 0.0 0.0 0.0 0.0 0.0 0.0 0.0 0.0 
POWER_3_3 = mem 0 0 0 0 0 0 0 0 0 0 0 0 
```

## socs/profpga-xcvu440-autonomous-driving/profpga-xcvu440-autonomous-driving_defconfig
```kconfig
CPU_ARCH = leon3
NCPU_TILE = 1
CONFIG_HAS_SG = y
CONFIG_NOC_ROWS = 4
CONFIG_NOC_COLS = 4
CONFIG_CACHE_EN = y
CONFIG_CACHE_RTL = y
CONFIG_CPU_CACHES = 512 4 4096 16
CONFIG_ACC_CACHES = 512 4
CONFIG_SLM_KBYTES = 256
#CONFIG_MON_DDR is not set
#CONFIG_MON_MEM is not set
#CONFIG_MON_INJ is not set
#CONFIG_MON_ROUTERS is not set
#CONFIG_MON_ACCELERATORS is not set
#CONFIG_MON_L2 is not set
#CONFIG_MON_LLC is not set
#CONFIG_MON_DVFS is not set
TILE_0_0 = 0 mem mem 0 0 0
TILE_0_1 = 1 misc IO 0 0 0
TILE_0_2 = 2 acc GEMM_STRATUS 0 0 0 basic_chk2048_dma32_word32_paral8 1 sld
TILE_0_3 = 3 mem mem 0 0 0
TILE_1_0 = 4 cpu cpu 0 0 0
TILE_1_1 = 5 empty empty 0 0 0
TILE_1_2 = 6 acc FFT_STRATUS 0 0 0 basic_fx32_dma32 1 sld
TILE_1_3 = 7 acc CONV2D_STRATUS 0 0 0 basic_dma32 1 sld
TILE_2_0 = 8 acc GEMM_STRATUS 0 0 0 basic_chk2048_dma32_word32_paral8 1 sld
TILE_2_1 = 9 acc CONV2D_STRATUS 0 0 0 basic_dma32 1 sld
TILE_2_2 = 10 empty empty 0 0 0
TILE_2_3 = 11 acc VITDODEC_STRATUS 0 0 0 basic_dma32 1 sld
TILE_3_0 = 12 mem mem 0 0 0
TILE_3_1 = 13 acc FFT_STRATUS 0 0 0 basic_fx32_dma32 1 sld
TILE_3_2 = 14 acc VITDODEC_STRATUS 0 0 0 basic_dma32 1 sld
TILE_3_3 = 15 mem mem 0 0 0
#CONFIG_HAS_DVFS is not set
CONFIG_VF_POINTS = 4
POWER_0_0 = mem 0 0 0 0 0 0 0 0 0 0 0 0 
POWER_0_1 = IO 0 0 0 0 0 0 0 0 0 0 0 0 
POWER_0_2 = GEMM_STRATUS 0.0 0.0 0.0 0.0 0.0 0.0 0.0 0.0 0.0 0.0 0.0 0.0 
POWER_0_3 = mem 0 0 0 0 0 0 0 0 0 0 0 0 
POWER_1_0 = cpu 0 0 0 0 0 0 0 0 0 0 0 0 
POWER_1_1 = empty 0 0 0 0 0 0 0 0 0 0 0 0 
POWER_1_2 = FFT_STRATUS 0.0 0.0 0.0 0.0 0.0 0.0 0.0 0.0 0.0 0.0 0.0 0.0 
POWER_1_3 = CONV2D_STRATUS 0.0 0.0 0.0 0.0 0.0 0.0 0.0 0.0 0.0 0.0 0.0 0.0 
POWER_2_0 = GEMM_STRATUS 0.0 0.0 0.0 0.0 0.0 0.0 0.0 0.0 0.0 0.0 0.0 0.0 
POWER_2_1 = CONV2D_STRATUS 0.0 0.0 0.0 0.0 0.0 0.0 0.0 0.0 0.0 0.0 0.0 0.0 
POWER_2_2 = empty 0 0 0 0 0 0 0 0 0 0 0 0 
POWER_2_3 = VITDODEC_STRATUS 0.0 0.0 0.0 0.0 0.0 0.0 0.0 0.0 0.0 0.0 0.0 0.0 
POWER_3_0 = mem 0 0 0 0 0 0 0 0 0 0 0 0 
POWER_3_1 = FFT_STRATUS 0.0 0.0 0.0 0.0 0.0 0.0 0.0 0.0 0.0 0.0 0.0 0.0 
POWER_3_2 = VITDODEC_STRATUS 0.0 0.0 0.0 0.0 0.0 0.0 0.0 0.0 0.0 0.0 0.0 0.0 
POWER_3_3 = mem 0 0 0 0 0 0 0 0 0 0 0 0 
```

## socs/profpga-xcvu440-computer-vision/profpga-xcvu440-computer-vision_defconfig
```kconfig
CPU_ARCH = leon3
NCPU_TILE = 1
CONFIG_HAS_SG = y
CONFIG_NOC_ROWS = 4
CONFIG_NOC_COLS = 4
CONFIG_CACHE_EN = y
CONFIG_CACHE_RTL = y
CONFIG_CPU_CACHES = 512 4 2048 16
CONFIG_ACC_CACHES = 512 4
CONFIG_SLM_KBYTES = 256
#CONFIG_MON_DDR is not set
#CONFIG_MON_MEM is not set
#CONFIG_MON_INJ is not set
#CONFIG_MON_ROUTERS is not set
#CONFIG_MON_ACCELERATORS is not set
#CONFIG_MON_L2 is not set
#CONFIG_MON_LLC is not set
#CONFIG_MON_DVFS is not set
TILE_0_0 = 0 cpu cpu 0 0 0
TILE_0_1 = 1 misc IO 0 0 0
TILE_0_2 = 2 empty empty 0 0 0
TILE_0_3 = 3 empty empty 0 0 0
TILE_1_0 = 4 acc SVHN_MLP_HLS4ML 0 0 0 dma32_w32 1 sld
TILE_1_1 = 5 empty empty 0 0 0
TILE_1_2 = 6 acc SVHN_AUTOENC_HLS4ML 0 0 0 dma32_w32 1 sld
TILE_1_3 = 7 acc SVHN_MLP_HLS4ML 0 0 0 dma32_w32 1 sld
TILE_2_0 = 8 mem mem 0 0 0
TILE_2_1 = 9 acc NIGHTVISION_STRATUS 0 0 0 fast_dma32_img1024_pxl3 1 sld
TILE_2_2 = 10 acc NIGHTVISION_STRATUS 0 0 0 fast_dma32_img1024_pxl3 1 sld
TILE_2_3 = 11 mem mem 0 0 0
TILE_3_0 = 12 acc SVHN_MLP_HLS4ML 0 0 0 dma32_w32 1 sld
TILE_3_1 = 13 acc NIGHTVISION_STRATUS 0 0 0 fast_dma32_img1024_pxl3 1 sld
TILE_3_2 = 14 acc NIGHTVISION_STRATUS 0 0 0 fast_dma32_img1024_pxl3 1 sld
TILE_3_3 = 15 acc SVHN_MLP_HLS4ML 0 0 0 dma32_w32 1 sld
#CONFIG_HAS_DVFS is not set
CONFIG_VF_POINTS = 4
POWER_0_0 = cpu 0 0 0 0 0 0 0 0 0 0 0 0 
POWER_0_1 = IO 0 0 0 0 0 0 0 0 0 0 0 0 
POWER_0_2 = empty 0 0 0 0 0 0 0 0 0 0 0 0 
POWER_0_3 = empty 0 0 0 0 0 0 0 0 0 0 0 0 
POWER_1_0 = SVHN_MLP_HLS4ML 0.0 0.0 0.0 0.0 0.0 0.0 0.0 0.0 0.0 0.0 0.0 0.0 
POWER_1_1 = empty 0 0 0 0 0 0 0 0 0 0 0 0 
POWER_1_2 = SVHN_AUTOENC_HLS4ML 0.0 0.0 0.0 0.0 0.0 0.0 0.0 0.0 0.0 0.0 0.0 0.0 
POWER_1_3 = SVHN_MLP_HLS4ML 0.0 0.0 0.0 0.0 0.0 0.0 0.0 0.0 0.0 0.0 0.0 0.0 
POWER_2_0 = mem 0 0 0 0 0 0 0 0 0 0 0 0 
POWER_2_1 = NIGHTVISION_STRATUS 0.0 0.0 0.0 0.0 0.0 0.0 0.0 0.0 0.0 0.0 0.0 0.0 
POWER_2_2 = NIGHTVISION_STRATUS 0.0 0.0 0.0 0.0 0.0 0.0 0.0 0.0 0.0 0.0 0.0 0.0 
POWER_2_3 = mem 0 0 0 0 0 0 0 0 0 0 0 0 
POWER_3_0 = SVHN_MLP_HLS4ML 0.0 0.0 0.0 0.0 0.0 0.0 0.0 0.0 0.0 0.0 0.0 0.0 
POWER_3_1 = NIGHTVISION_STRATUS 0.0 0.0 0.0 0.0 0.0 0.0 0.0 0.0 0.0 0.0 0.0 0.0 
POWER_3_2 = NIGHTVISION_STRATUS 0.0 0.0 0.0 0.0 0.0 0.0 0.0 0.0 0.0 0.0 0.0 0.0 
POWER_3_3 = SVHN_MLP_HLS4ML 0.0 0.0 0.0 0.0 0.0 0.0 0.0 0.0 0.0 0.0 0.0 0.0 
```
